## CMakeLists.txt
```
cmake_minimum_required(VERSION 3.20.0)
find_package(Zephyr REQUIRED HINTS $ENV{ZEPHYR_BASE})
project(sensor_node_lib_tests LANGUAGES C)

set(LIB ${CMAKE_CURRENT_SOURCE_DIR}/../../src/lib)
target_sources(app PRIVATE
  src/test_ring_buffer.c
  src/test_moving_average.c
  src/test_alarm.c
  ${LIB}/ring_buffer.c
  ${LIB}/moving_average.c
  ${LIB}/alarm.c
)
target_include_directories(app PRIVATE ${LIB})
```

## prj.conf
```kconfig
CONFIG_ZTEST=y
CONFIG_ZTEST_SHUFFLE=n
```

## src/test_alarm.c
```c
#include <errno.h>

#include <zephyr/ztest.h>

#include "alarm.h"

#define HIGH  30000
#define CLEAR 28000

static struct alarm a;

static void reset(void *fixture)
{
	ARG_UNUSED(fixture);
	zassert_ok(alarm_init(&a, HIGH, CLEAR, 3U));
}

ZTEST_SUITE(alarm, NULL, NULL, reset, NULL, NULL);

/* Verifies: REQ-003, REQ-004 */
ZTEST(alarm, test_rejects_inconsistent_thresholds)
{
	struct alarm b;

	zassert_equal(alarm_init(&b, 30000, 30000, 3U), -EINVAL, "no hysteresis");
	zassert_equal(alarm_init(&b, 30000, 31000, 3U), -EINVAL);
	zassert_equal(alarm_init(&b, 30000, 28000, 0U), -EINVAL);
}

/* Verifies: REQ-003 */
ZTEST(alarm, test_raised_when_the_average_reaches_the_threshold)
{
	zassert_equal(alarm_update(&a, HIGH - 1), ALARM_NO_CHANGE);
	zassert_equal(a.state, ALARM_NORMAL);
	zassert_equal(alarm_update(&a, HIGH), ALARM_RAISED, "reaching it is enough");
	zassert_equal(a.state, ALARM_HIGH);
	zassert_equal(alarm_update(&a, HIGH + 5000), ALARM_NO_CHANGE, "raised once");
}

/* Verifies: REQ-004 */
ZTEST(alarm, test_hysteresis_no_chatter_around_the_threshold)
{
	zassert_equal(alarm_update(&a, HIGH), ALARM_RAISED);
	/* Wandering just below the threshold does not clear it... */
	for (int i = 0; i < 10; i++) {
		zassert_equal(alarm_update(&a, (i % 2 == 0) ? HIGH - 1 : HIGH + 1), ALARM_NO_CHANGE);
		zassert_equal(alarm_update(&a, CLEAR + 1), ALARM_NO_CHANGE);
	}
	/* ...only falling to the clear threshold does. */
	zassert_equal(alarm_update(&a, CLEAR), ALARM_CLEARED);
	zassert_equal(a.state, ALARM_NORMAL);
	zassert_equal(alarm_update(&a, HIGH - 1), ALARM_NO_CHANGE, "and it is not raised again below HIGH");
}

/* Verifies: REQ-005 */
ZTEST(alarm, test_fault_after_consecutive_failed_reads_only)
{
	zassert_equal(alarm_read_failed(&a), ALARM_NO_CHANGE);
	zassert_equal(alarm_read_failed(&a), ALARM_NO_CHANGE);
	zassert_equal(alarm_update(&a, 25000), ALARM_NO_CHANGE, "a good reading resets the count");
	zassert_equal(alarm_read_failed(&a), ALARM_NO_CHANGE);
	zassert_equal(alarm_read_failed(&a), ALARM_NO_CHANGE);
	zassert_equal(alarm_read_failed(&a), ALARM_FAULTED, "the third in a row");
	zassert_equal(a.state, ALARM_FAULT);
	zassert_equal(alarm_read_failed(&a), ALARM_NO_CHANGE, "reported once");
}

/* Verifies: REQ-005 */
ZTEST(alarm, test_recovers_into_the_state_the_average_calls_for)
{
	for (int i = 0; i < 3; i++) {
		(void)alarm_read_failed(&a);
	}
	zassert_equal(alarm_update(&a, 25000), ALARM_RECOVERED);
	zassert_equal(a.state, ALARM_NORMAL);

	for (int i = 0; i < 3; i++) {
		(void)alarm_read_failed(&a);
	}
	zassert_equal(alarm_update(&a, HIGH + 1), ALARM_RECOVERED);
	zassert_equal(a.state, ALARM_HIGH);
}

/* Verifies: REQ-005 */
ZTEST(alarm, test_state_names)
{
	zassert_str_equal(alarm_state_name(ALARM_NORMAL), "NORMAL");
	zassert_str_equal(alarm_state_name(ALARM_HIGH), "HIGH");
	zassert_str_equal(alarm_state_name(ALARM_FAULT), "FAULT");
}
```

## src/test_moving_average.c
```c
#include <errno.h>

#include <zephyr/ztest.h>

#include "moving_average.h"

static struct moving_average ma;

ZTEST_SUITE(moving_average, NULL, NULL, NULL, NULL, NULL);

/* Verifies: REQ-002 */
ZTEST(moving_average, test_rejects_invalid_windows)
{
	zassert_equal(ma_init(&ma, 0U), -EINVAL);
	zassert_equal(ma_init(&ma, MA_MAX_WINDOW + 1U), -EINVAL);
	zassert_equal(ma_init(&ma, MA_MAX_WINDOW), 0);
}

/* Verifies: REQ-002 */
ZTEST(moving_average, test_averages_what_it_has_until_the_window_is_full)
{
	zassert_ok(ma_init(&ma, 4U));
	zassert_equal(ma_add(&ma, 1000), 1000);
	zassert_equal(ma_add(&ma, 2000), 1500);
	zassert_equal(ma_add(&ma, 3000), 2000);
	zassert_equal(ma_add(&ma, 4000), 2500);
}

/* Verifies: REQ-002 */
ZTEST(moving_average, test_oldest_reading_leaves_the_window)
{
	zassert_ok(ma_init(&ma, 4U));
	for (int32_t v = 1; v <= 4; v++) {
		(void)ma_add(&ma, v * 1000);
	}
	zassert_equal(ma_add(&ma, 9000), 4500, "(2000 + 3000 + 4000 + 9000) / 4");
	zassert_equal(ma_add(&ma, 9000), 6250);
}

/* Verifies: REQ-002, REQ-008 */
ZTEST(moving_average, test_rounds_to_nearest_for_negative_values_too)
{
	zassert_ok(ma_init(&ma, 2U));
	(void)ma_add(&ma, 1);
	zassert_equal(ma_add(&ma, 2), 2, "1.5 rounds away from zero");

	zassert_ok(ma_init(&ma, 2U));
	(void)ma_add(&ma, -1);
	zassert_equal(ma_add(&ma, -2), -2, "-1.5 rounds away from zero, not toward it");

	zassert_ok(ma_init(&ma, 3U));
	(void)ma_add(&ma, -1000);
	(void)ma_add(&ma, -1000);
	zassert_equal(ma_add(&ma, -1001), -1000, "-1000.33 rounds to -1000");
}

/* Verifies: REQ-008 */
ZTEST(moving_average, test_full_window_of_extremes_does_not_overflow)
{
	zassert_ok(ma_init(&ma, MA_MAX_WINDOW));
	for (uint32_t i = 0U; i < 3U * MA_MAX_WINDOW; i++) {
		zassert_equal(ma_add(&ma, INT32_MAX), INT32_MAX);
	}
	for (uint32_t i = 0U; i < MA_MAX_WINDOW; i++) {
		(void)ma_add(&ma, INT32_MIN);
	}
	zassert_equal(ma_add(&ma, INT32_MIN), INT32_MIN);
}
```

## src/test_ring_buffer.c
```c
#include <zephyr/ztest.h>

#include "ring_buffer.h"

static struct ring_buffer rb;

static void reset(void *fixture)
{
	ARG_UNUSED(fixture);
	rb_init(&rb);
}

ZTEST_SUITE(ring_buffer, NULL, NULL, reset, NULL, NULL);

/* Verifies: REQ-007 */
ZTEST(ring_buffer, test_empty_has_no_stats)
{
	struct rb_stats s;

	zassert_equal(rb_count(&rb), 0U);
	zassert_false(rb_stats(&rb, &s));
}

/* Verifies: REQ-007 */
ZTEST(ring_buffer, test_keeps_insertion_order)
{
	for (int32_t v = 1; v <= 5; v++) {
		rb_push(&rb, v * 10);
	}
	zassert_equal(rb_count(&rb), 5U);
	for (uint32_t i = 0U; i < 5U; i++) {
		zassert_equal(rb_get(&rb, i), (int32_t)(i + 1U) * 10);
	}
}

/* Verifies: REQ-007 */
ZTEST(ring_buffer, test_full_buffer_overwrites_the_oldest)
{
	for (int32_t v = 0; v < (int32_t)RB_CAPACITY + 10; v++) {
		rb_push(&rb, v);
	}
	zassert_equal(rb_count(&rb), RB_CAPACITY);
	zassert_equal(rb_get(&rb, 0U), 10, "the 10 oldest are gone");
	zassert_equal(rb_get(&rb, RB_CAPACITY - 1U), (int32_t)RB_CAPACITY + 9);
}

/* Verifies: REQ-007, REQ-008 */
ZTEST(ring_buffer, test_stats)
{
	struct rb_stats s;

	rb_push(&rb, -1500);
	rb_push(&rb, 2000);
	rb_push(&rb, 31250);
	zassert_true(rb_stats(&rb, &s));
	zassert_equal(s.count, 3U);
	zassert_equal(s.min, -1500);
	zassert_equal(s.max, 31250);
	zassert_equal(s.mean, 10583, "31750 / 3 = 10583.33");
}

/* Verifies: REQ-008 */
ZTEST(ring_buffer, test_mean_of_extremes_does_not_overflow)
{
	struct rb_stats s;

	for (uint32_t i = 0U; i < RB_CAPACITY; i++) {
		rb_push(&rb, INT32_MAX);
	}
	zassert_true(rb_stats(&rb, &s));
	zassert_equal(s.mean, INT32_MAX);

	rb_init(&rb);
	for (uint32_t i = 0U; i < RB_CAPACITY; i++) {
		rb_push(&rb, INT32_MIN);
	}
	zassert_true(rb_stats(&rb, &s));
	zassert_equal(s.mean, INT32_MIN);
}
```
